// SPDX-License-Identifier: Apache-2.0
//
// A heartbeat LED on GPIO 17 (header pin 11), visible as
// /sys/class/leds/hello-layer. Uses only drivers built into the stock
// kernel (gpio-leds, the heartbeat trigger).

/dts-v1/;
/plugin/;

#include <dt-bindings/gpio/gpio.h>

/ {
	compatible = "brcm,bcm2835";

	fragment@0 {
		target-path = "/";
		__overlay__ {
			hello-layer-leds {
				compatible = "gpio-leds";

				led-hello-layer {
					label = "hello-layer";
					gpios = <&gpio 17 GPIO_ACTIVE_HIGH>;
					linux,default-trigger = "heartbeat";
				};
			};
		};
	};
};
